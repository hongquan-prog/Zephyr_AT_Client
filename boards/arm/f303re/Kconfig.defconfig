## boards/arm/f303re/Kconfig.defconfig
```kconfig
# NUCLEO-64 F302R8 board configuration

# Copyright (c) 2020 Paul M. Bendixen
# SPDX-License-Identifier: Apache-2.0

if BOARD_F303RE

config BOARD
	default "stm32f303re"

endif # BOARD_F303RE
```
